## client/c/esp32-idf-c/sdkconfig.defaults
```kconfig
CONFIG_PARTITION_TABLE_TWO_OTA=y
CONFIG_ESP_TASK_WDT_TIMEOUT_S=30
CONFIG_FREERTOS_HZ=1000
```

## client/c/esp32-network-analyzer-idf-c/main/Kconfig.projbuild
```kconfig
menu "Extrittio Network Analyzer"

config EXTRITTIO_DEVICE_ID
    string "Device ID"
    default "esp32-network-analyzer-001"
    help
        Unique identifier for this analyzer device.

config EXTRITTIO_WIFI_SSID
    string "WiFi SSID"
    default ""
    help
        WiFi network name.

config EXTRITTIO_WIFI_PASSWORD
    string "WiFi Password"
    default ""
    help
        WiFi network password.

config EXTRITTIO_ZENOH_CONNECT
    string "Zenoh endpoint"
    default "tcp/192.0.2.100:7447"
    help
        Zenoh router endpoint to connect to.

config EXTRITTIO_SCAN_INTERVAL_S
    int "Network scan interval (seconds)"
    default 60
    range 10 3600
    help
        Seconds between local network scans.

config EXTRITTIO_HEARTBEAT_INTERVAL_S
    int "Heartbeat interval (seconds)"
    default 60
    range 10 3600
    help
        Seconds between heartbeat publishes.

config EXTRITTIO_ANALYZER_MAX_SCAN_TARGETS
    int "Maximum IPv4 scan targets"
    default 254
    range 1 1024
    help
        Maximum number of local subnet IPv4 addresses to ping per scan.

config EXTRITTIO_ANALYZER_MAX_HOSTS
    int "Maximum reported hosts"
    default 48
    range 1 128
    help
        Maximum reachable hosts included in each telemetry snapshot.

config EXTRITTIO_ANALYZER_PING_TIMEOUT_MS
    int "Probe timeout per host (ms)"
    default 120
    range 20 1000
    help
        Timeout for each one-shot ARP or metadata probe.

config EXTRITTIO_ANALYZER_SNAPSHOT_BYTES
    int "Snapshot JSON buffer bytes"
    default 6144
    range 1024 12000
    help
        Maximum JSON snapshot size stored in telemetry metadata.

config EXTRITTIO_FIRMWARE_VERSION
    string "Firmware version"
    default "v1.0.0-network-analyzer-c"
    help
        Reported firmware version string.

endmenu
```

## client/c/esp32-network-analyzer-idf-c/sdkconfig.defaults
```kconfig
CONFIG_PARTITION_TABLE_TWO_OTA=y
CONFIG_ESPTOOLPY_FLASHSIZE_4MB=y
CONFIG_ESP_TASK_WDT_TIMEOUT_S=30
CONFIG_FREERTOS_HZ=1000
CONFIG_ESP_MAIN_TASK_STACK_SIZE=8192
CONFIG_EXTRITTIO_ANALYZER_SNAPSHOT_BYTES=6144
```

## client/esp32-idf-c/Kconfig.projbuild
```kconfig
menu "Extrittio Configuration"

config EXTRITTIO_DEVICE_ID
    string "Device ID"
    default "esp32-c-001"
    help
        Unique identifier for this device.

config EXTRITTIO_WIFI_SSID
    string "WiFi SSID"
    default ""
    help
        WiFi network name.

config EXTRITTIO_WIFI_PASSWORD
    string "WiFi Password"
    default ""
    help
        WiFi network password.

config EXTRITTIO_ZENOH_CONNECT
    string "Zenoh endpoint"
    default "tcp/192.0.2.100:7447"
    help
        Zenoh router endpoint to connect to.

config EXTRITTIO_TELEMETRY_INTERVAL_S
    int "Telemetry interval (seconds)"
    default 5
    help
        Seconds between telemetry publishes.

config EXTRITTIO_HEARTBEAT_INTERVAL_S
    int "Heartbeat interval (seconds)"
    default 30
    help
        Seconds between heartbeat publishes.

config EXTRITTIO_FIRMWARE_VERSION
    string "Firmware version"
    default "v1.0.0-esp32c"
    help
        Reported firmware version string.

endmenu
```

## clients/c/esp32-idf-c/sdkconfig.defaults
```kconfig
CONFIG_PARTITION_TABLE_TWO_OTA=y
CONFIG_BOOTLOADER_APP_ROLLBACK_ENABLE=y
CONFIG_ESPTOOLPY_FLASHSIZE_4MB=y
CONFIG_ESP_TASK_WDT_TIMEOUT_S=30
CONFIG_FREERTOS_HZ=1000
```

## clients/c/esp32c6-openthread-idf-c/main/Kconfig.projbuild
```kconfig
menu "Extrittio Thread Device"

config EXTRITTIO_DEVICE_ID
    string "Device ID"
    default "esp32c6-thread-001"
    help
        Unique identifier registered in Extrittio.

config EXTRITTIO_THREAD_ZENOH_SERVICE_NAME
    string "Thread DNS-SD Zenoh service"
    default "_extrittio-zenoh._tcp.default.service.arpa."
    help
        Fully-qualified Thread DNS-SD service advertised by Extrittio Edge
        server. The default matches EXTRITTIO_THREAD_ZENOH_SERVICE_NAME on the
        server and OTBR's default service-discovery domain.

config EXTRITTIO_THREAD_ZENOH_INSTANCE_NAME
    string "Thread DNS-SD Zenoh instance"
    default "extrittio-backend"
    help
        Stable DNS-SD instance advertised by the Extrittio Edge server. The
        default matches EXTRITTIO_THREAD_ZENOH_SERVICE_INSTANCE on the server.

config EXTRITTIO_THREAD_ZENOH_LOCATOR
    string "Thread Zenoh locator fallback"
    default "tcp/[fd35:3441:33d1:d73e:9ead:6dbd:a06b:da7]:7447"
    help
        Direct Zenoh locator used after three failed Thread DNS-SD discovery
        attempts. The development default targets the bundled development
        Thread network. For a custom network, replace it with the address from
        the Extrittio Thread DNS-SD advertisement log. Leave it empty to
        require DNS-SD discovery.

config EXTRITTIO_THREAD_ACTIVE_DATASET_TLVS
    string "Thread Active Operational Dataset (hex TLVs)"
    default ""
    help
        Hex-encoded Active Operational Dataset exported from Extrittio's Thread
        Network settings. The dataset contains the Thread network key; do not
        commit it to source control or share a generated sdkconfig file.

config EXTRITTIO_THREAD_CLEAR_PERSISTENT_STATE_ON_BOOT
    bool "Clear persisted OpenThread state before joining"
    default y
    help
        Rejoin the configured Thread network on every boot instead of restoring
        the prior child state. This prevents stale link-security counters after
        the local OTBR or device firmware is restarted. Disable only when the
        device must preserve a network joined through commissioning.

config EXTRITTIO_THREAD_TX_POWER_DBM
    int "Thread radio transmit power (dBm)"
    range -24 20
    default 20
    help
        Transmit power used by the ESP32-C6 802.15.4 radio. The OpenThread
        upstream default is 0 dBm, which is unnecessarily weak for a
        standalone Thread node. Keep this at the board's supported maximum
        unless local radio regulations or power constraints require less.

config EXTRITTIO_TELEMETRY_INTERVAL_S
    int "Telemetry interval (seconds)"
    range 1 3600
    default 30

config EXTRITTIO_HEARTBEAT_INTERVAL_S
    int "Heartbeat interval (seconds)"
    range 5 86400
    default 60

config EXTRITTIO_FIRMWARE_VERSION
    string "Firmware version"
    default "v1.0.0-esp32c6-thread-c"

endmenu
```

## clients/c/sdk-c/zephyr/Kconfig
```kconfig
# Copyright (c) 2026 Extrittio contributors
# SPDX-License-Identifier: Apache-2.0

menuconfig EXTRITTIO_SDK_C
	bool "Extrittio embedded C SDK"
	default y
	depends on ZEPHYR_NANOPB_MODULE
	depends on ZEPHYR_ZENOH_PICO_MODULE
	select NANOPB
	select ZENOH_PICO
	help
	  Build Extrittio's portable protocol, provisioning, contract, shadow,
	  command, telemetry, logging, heartbeat, and OTA helpers.

if EXTRITTIO_SDK_C

config EXTRITTIO_PROVISIONING_MAX_PAYLOAD
	int "Maximum BLE bootstrap payload size"
	default 24576
	range 4096 65536
	help
	  Maximum accepted bootstrap JSON size. The payload is streamed directly
	  to flash and is not retained in RAM while it is transferred.

endif
```

## clients/zephyr/modules/zenoh-pico/Kconfig
```kconfig
# Extrittio extension of zenoh-pico 1.9.0's Zephyr Kconfig.

config ZENOH_PICO
	bool "Zenoh PICO library"

if ZENOH_PICO

config ZENOH_PICO_LINK_SERIAL
	bool "Serial link"

config ZENOH_PICO_MULTI_THREAD
	bool "Multithreading support"

config ZENOH_PICO_PUBLICATION
	bool "Publication support"

config ZENOH_PICO_SUBSCRIPTION
	bool "Subscription support"

config ZENOH_PICO_QUERY
	bool "Query support"

config ZENOH_PICO_QUERYABLE
	bool "Queryable support"

config ZENOH_PICO_RAWETH_TRANSPORT
	bool "Raw Ethernet support"

config ZENOH_PICO_LINK_TCP
	bool "TCP link"
	depends on NET_TCP

config ZENOH_PICO_LINK_TLS
	bool "TLS link"
	depends on ZENOH_PICO_LINK_TCP
	depends on MBEDTLS
	help
	  Enable zenoh-pico's TLS locator and mTLS client credentials on Zephyr.
	  This fills the Zephyr integration gap in the pinned upstream 1.9.0
	  release without changing zenoh-pico's protocol implementation.

config ZENOH_PICO_LINK_UDP_UNICAST
	bool "UDP unicast"

config ZENOH_PICO_LINK_UDP_MULTICAST
	bool "UDP multicast"

config ZENOH_PICO_SCOUTING
	bool "Scouting UDP"

config ZENOH_PICO_LINK_WS
	bool "WebSocket link"

endif
```
